## configs/zynq_mitx_RSA_defconfig
```kconfig
CONFIG_SPL=y
+S:CONFIG_ARM=y
+S:CONFIG_ZYNQ=y
+S:CONFIG_TARGET_ZYNQ_MITX=y
CONFIG_OF_CONTROL=n
CONFIG_DEFAULT_DEVICE_TREE="zynq-mini-itx"
CONFIG_CMD_ZYNQ_RSA=y
```
